// Telemetry page on the ESP32: see include/web_telemetry.h.
#include "web_telemetry.h"
#include <Arduino.h>
#include "esp_http_server.h"
#include "freertos/FreeRTOS.h"
#include "freertos/semphr.h"
#include "tlm_page.h"
#include "web_server.h"
#include "web_telemetry_page_gz.h"  // generated by tools/gen_web_telemetry_page.py
#include "usb_ota.h"

extern bool update_mode;  // src/main.cpp: an update runs (page upload, "ota url", "stm url")

extern "C" const char* rover_fw_version();  // src/main.cpp
void webTelemetryCopy(tlmpage::Snapshot* s);  // src/main.cpp: loop() copies the newest values

namespace webtlm {
namespace {

enum : uint8_t { IDLE, PENDING, RUNNING, DONE };
volatile uint8_t s_state = IDLE;
SemaphoreHandle_t s_done = nullptr;
portMUX_TYPE s_mux = portMUX_INITIALIZER_UNLOCKED;
tlmpage::Snapshot s_snap;  // static: a late copy never hits freed memory
constexpr uint32_t WAIT_MS = 2000;

// Server task: asks loop() for a copy and waits. false: no copy within WAIT_MS.
bool take() {
  if (s_state != IDLE) return false;
  xSemaphoreTake(s_done, 0);  // no old give
  s_state = PENDING;
  if (xSemaphoreTake(s_done, pdMS_TO_TICKS(WAIT_MS)) == pdTRUE) return true;
  portENTER_CRITICAL(&s_mux);
  const uint8_t st = s_state;
  if (st == PENDING) s_state = IDLE;  // loop() did not take it: withdrawn
  portEXIT_CRITICAL(&s_mux);
  if (st == PENDING) return false;
  if (xSemaphoreTake(s_done, pdMS_TO_TICKS(100)) == pdTRUE) return true;  // loop() copies now: microseconds
  s_state = IDLE;  // never stuck: a late give only wakes the next request with a fresh copy
  return false;
}

bool send_chunk(void* ctx, const char* text, size_t len) {
  return httpd_resp_send_chunk((httpd_req_t*)ctx, text, len) == ESP_OK;
}

esp_err_t page_get(httpd_req_t* req) {
  httpd_resp_set_type(req, "text/html; charset=utf-8");
  httpd_resp_set_hdr(req, "Content-Encoding", "gzip");
  httpd_resp_set_hdr(req, "Cache-Control", "no-cache");
  return httpd_resp_send(req, (const char*)WEB_TELEMETRY_PAGE_GZ, sizeof(WEB_TELEMETRY_PAGE_GZ));
}

// During an update the page answers in a few bytes and takes no copy: an answer holds TCP send buffers, and a settings
// answer beside an upload took the free heap to 1 340 B (bench, 2026-10-17).
bool updating() { return update_mode || usb_ota::busy(); }

esp_err_t api_get(httpd_req_t* req) {
  if (updating()) {
    httpd_resp_set_status(req, "503 Service Unavailable");
    httpd_resp_set_type(req, "text/plain; charset=utf-8");
    return httpd_resp_sendstr(req, "An update runs: try again when it ends");
  }
  char q[32] = "", v[4] = "";
  const bool has_q = httpd_req_get_url_query_str(req, q, sizeof(q)) == ESP_OK;
  httpd_resp_set_type(req, "application/json");
  httpd_resp_set_hdr(req, "Cache-Control", "no-store");
  bool ok;
  if (has_q && httpd_query_key_value(q, "def", v, sizeof(v)) == ESP_OK && v[0] == '1') {
    ok = tlmpage::def_answer(rover_fw_version(), send_chunk, req);
  } else {
    const bool all = has_q && httpd_query_key_value(q, "all", v, sizeof(v)) == ESP_OK && v[0] == '1';
    if (!take()) {
      httpd_resp_set_status(req, "503 Service Unavailable");
      httpd_resp_set_type(req, "text/plain; charset=utf-8");
      return httpd_resp_sendstr(req, "No answer from the vehicle: try again");
    }
    const tlmpage::Heap h = {(uint32_t)ESP.getFreeHeap(), (uint32_t)ESP.getMinFreeHeap(), (uint32_t)ESP.getMaxAllocHeap()};
    ok = tlmpage::values_answer(s_snap, all, h, send_chunk, req);
    s_state = IDLE;
  }
  if (!ok) return ESP_FAIL;
  return httpd_resp_send_chunk(req, nullptr, 0);
}

void reg(httpd_handle_t server) {
  static const httpd_uri_t U[] = {
      {"/telemetry", HTTP_GET, page_get, nullptr},
      {"/api/telemetry", HTTP_GET, api_get, nullptr},
  };
  for (const httpd_uri_t& u : U) httpd_register_uri_handler(server, &u);
}

}  // namespace

void begin() {
  if (!s_done) s_done = xSemaphoreCreateBinary();
  web::addPage("/telemetry", "Telemetry", reg);
}

void service(uint32_t) {
  if (s_state != PENDING) return;
  portENTER_CRITICAL(&s_mux);
  const bool go = s_state == PENDING;
  if (go) s_state = RUNNING;
  portEXIT_CRITICAL(&s_mux);
  if (!go) return;
  webTelemetryCopy(&s_snap);
  s_state = DONE;
  xSemaphoreGive(s_done);
}

}  // namespace webtlm
