// Settings page on the ESP32: see include/web_settings.h.
#include "web_settings.h"
#include <ArduinoJson.h>
#include "esp_http_server.h"
#include "freertos/FreeRTOS.h"
#include "freertos/semphr.h"
#include "usb_msc_fat.h"
#include "web_server.h"
#include "web_settings_page_gz.h"  // generated by tools/gen_web_settings_page.py
#include "usb_ota.h"

extern bool update_mode;  // src/platform/updates.inc: an update runs (page upload, "ota url", "stm url")

extern DeviceConfig g_deviceConfig;                 // src/platform/settings.inc
extern int8_t drive_mode_status;
extern "C" const char* rover_fw_version();
bool vehicleStationary();
void restartApp();
uint8_t webCommand(const char* t, String& reply, bool* deferred);

namespace webcfg {
namespace {

enum : uint8_t { IDLE, PENDING, RUNNING, WAIT_ANSWER, DONE };

// One request at a time: the server task handles its requests one after the other.
struct Request {
  volatile uint8_t state;
  bool abandoned;        // the server task stopped its wait: loop() frees the slot when it is done
  char text[112];        // the command line; "" = copy the settings to snap
  char key[48];          // a set: its key, for the value after the command
  uint8_t code;
  String reply, value;   // the answer, and a set's value after the command (as "get" gives it)
  bool running, moving;  // autonomous mode; the vehicle moves (a save is refused in both)
};
Request s_req;
SemaphoreHandle_t s_done = nullptr;
portMUX_TYPE s_mux = portMUX_INITIALIZER_UNLOCKED;
DeviceConfig s_snap;  // GET /api/settings: loop() copies the settings here (static: a late copy never hits freed memory)
uint32_t s_restart_at = 0;
constexpr uint32_t WAIT_MS = 5000;  // a save or an erase writes flash in loop() (about 1 s)
constexpr size_t BODY_MAX = 256;
constexpr size_t OUT_SIZE = 1536, ITEM_ROOM = 640;  // GET /api/settings: send buffer; room kept for one key

// loop(): the answer to the server task
void finish(uint8_t code, const String& reply) {
  s_req.code = code;
  s_req.reply = reply;
  s_req.value = "";
  if (s_req.key[0]) msc_fat_get_key(&g_deviceConfig, s_req.key, &s_req.value);
  s_req.running = drive_mode_status == 2;
  s_req.moving = !vehicleStationary();
  if (code == 0 && !strcmp(s_req.text, "restart")) s_restart_at = (millis() + 500) | 1;  // the answer goes out first
  portENTER_CRITICAL(&s_mux);
  const bool gone = s_req.abandoned;
  s_req.abandoned = false;
  s_req.state = gone ? IDLE : DONE;
  portEXIT_CRITICAL(&s_mux);
  if (!gone) xSemaphoreGive(s_done);
}

// Server task: hands one request to loop() and waits. false: a request still runs, or no answer within WAIT_MS.
bool run(const char* text, const char* key) {
  if (s_req.state != IDLE) return false;
  strlcpy(s_req.text, text, sizeof(s_req.text));
  strlcpy(s_req.key, key, sizeof(s_req.key));
  xSemaphoreTake(s_done, 0);  // no old give
  s_req.state = PENDING;
  if (xSemaphoreTake(s_done, pdMS_TO_TICKS(WAIT_MS)) == pdTRUE) return true;
  portENTER_CRITICAL(&s_mux);
  const uint8_t st = s_req.state;
  if (st == PENDING) s_req.state = IDLE;                   // loop() did not take it: withdrawn
  else if (st != DONE) s_req.abandoned = true;             // it runs: loop() frees the slot
  portEXIT_CRITICAL(&s_mux);
  if (st != DONE) return false;
  xSemaphoreTake(s_done, 0);
  return true;
}
void release() { s_req.state = IDLE; }

esp_err_t send_text(httpd_req_t* req, const char* status, const char* text) {
  httpd_resp_set_status(req, status);
  httpd_resp_set_type(req, "text/plain; charset=utf-8");
  return httpd_resp_sendstr(req, text);
}
esp_err_t busy(httpd_req_t* req) { return send_text(req, "503 Service Unavailable", "No answer from the vehicle: try again"); }
// During an update the page answers in a few bytes: a settings answer holds about 5 KB of TCP send buffers, and an
// upload beside it took the free heap to 1 340 B (bench, 2026-10-17).
bool updating() { return update_mode || usb_ota::busy(); }
esp_err_t update_busy(httpd_req_t* req) { return send_text(req, "503 Service Unavailable", "An update runs: try again when it ends"); }

esp_err_t page_get(httpd_req_t* req) {
  httpd_resp_set_type(req, "text/html; charset=utf-8");
  httpd_resp_set_hdr(req, "Content-Encoding", "gzip");
  httpd_resp_set_hdr(req, "Cache-Control", "no-cache");
  return httpd_resp_send(req, (const char*)WEB_SETTINGS_PAGE_GZ, sizeof(WEB_SETTINGS_PAGE_GZ));
}

// Every table key, one JSON object each, in table order, from a copy of the settings that loop() takes.
esp_err_t settings_get(httpd_req_t* req) {
  if (updating()) return update_busy(req);
  if (!run("", "")) return busy(req);
  char* out = (char*)malloc(OUT_SIZE);
  if (!out) { release(); return send_text(req, "503 Service Unavailable", "No memory: try again"); }
  const bool running = s_req.running, moving = s_req.moving;
  release();
  httpd_resp_set_type(req, "application/json");
  httpd_resp_set_hdr(req, "Cache-Control", "no-store");
  size_t n = snprintf(out, OUT_SIZE, "{\"fw\":\"%s\",\"run\":\"%s\",\"moving\":%s,\"heap\":%u,\"heap_min\":%u,\"maxblk\":%u,\"web_stack_free\":%u,\"settings\":[",
                      rover_fw_version(), running ? "running" : "stopped", moving ? "true" : "false",
                      (unsigned)ESP.getFreeHeap(), (unsigned)ESP.getMinFreeHeap(), (unsigned)ESP.getMaxAllocHeap(),
                      (unsigned)(uxTaskGetStackHighWaterMark(nullptr) * sizeof(StackType_t)));
  int count = 0, skipped = 0;
  esp_err_t err = ESP_OK;
  for (int i = 0; err == ESP_OK; i++) {
    if (n > OUT_SIZE - ITEM_ROOM) { err = httpd_resp_send_chunk(req, out, n); n = 0; }
    const size_t at = n + (count ? 1 : 0);
    const int r = msc_fat_setting_json(&s_snap, i, out + at, OUT_SIZE - at - 4);
    if (r < 0 && r != -2) break;  // past the last line
    if (r == -2) { skipped++; continue; }
    if (r == 0) continue;           // no key (an older config.json only)
    if (count) out[n] = ',';
    n = at + strlen(out + at);
    count++;
  }
  if (err == ESP_OK) {
    n += snprintf(out + n, OUT_SIZE - n, "],\"count\":%d,\"skipped\":%d}", count, skipped);
    err = httpd_resp_send_chunk(req, out, n);
  }
  if (err == ESP_OK) err = httpd_resp_send_chunk(req, nullptr, 0);
  free(out);
  return err;
}

// The body of a POST into buf (0-terminated). false: too long, or the connection failed.
bool read_body(httpd_req_t* req, char* buf, size_t cap) {
  if (req->content_len >= cap) return false;
  size_t got = 0;
  while (got < req->content_len) {
    const int r = httpd_req_recv(req, buf + got, req->content_len - got);
    if (r == HTTPD_SOCK_ERR_TIMEOUT) continue;
    if (r <= 0) return false;
    got += r;
  }
  buf[got] = 0;
  return true;
}

// One command through loop(); the answer as JSON: {"code", "reply", ["value",] "run", "moving"}
esp_err_t command(httpd_req_t* req, const char* text, const char* key) {
  if (updating()) return update_busy(req);
  if (!run(text, key)) return busy(req);
  JsonDocument d;
  d["code"] = s_req.code;
  d["reply"] = s_req.reply;  // a copy
  if (key[0] && s_req.value.length()) d["value"] = serialized(s_req.value);  // a JSON literal, copied
  d["run"] = s_req.running ? "running" : "stopped";
  d["moving"] = s_req.moving;
  release();
  String body;
  serializeJson(d, body);
  httpd_resp_set_type(req, "application/json");
  httpd_resp_set_hdr(req, "Cache-Control", "no-store");
  return httpd_resp_send(req, body.c_str(), body.length());
}

// The text of a set from the body {"key": k, "value": v}: "set k v", as typed on USB. v: text (the rest of the line,
// as USB takes it), a number or true/false. false: not such a body.
bool set_text(const char* body, char* text, size_t cap, char* key, size_t key_cap) {
  JsonDocument d;
  if (deserializeJson(d, body)) return false;
  const char* k = d["key"] | "";
  const size_t kn = strlen(k);
  if (kn == 0 || kn >= key_cap) return false;
  for (const char* p = k; *p; p++)
    if (!isalnum((unsigned char)*p) && *p != '_') return false;  // a key: letters, digits and '_' only
  JsonVariantConst v = d["value"];
  char val[72];
  if (v.is<const char*>()) {
    const char* s = v.as<const char*>();
    if (strlen(s) >= sizeof(val)) return false;
    for (const char* p = s; *p; p++)
      if ((unsigned char)*p < 0x20) return false;  // one line only
    strcpy(val, s);
  } else if (v.is<bool>()) {
    strcpy(val, v.as<bool>() ? "true" : "false");
  } else if (v.is<long>() || v.is<double>()) {
    serializeJson(v, val, sizeof(val));
  } else {
    return false;
  }
  strcpy(key, k);
  return snprintf(text, cap, "set %s %s", k, val) < (int)cap;
}

esp_err_t set_post(httpd_req_t* req) {
  char body[BODY_MAX], text[sizeof(s_req.text)], key[sizeof(s_req.key)];
  if (!read_body(req, body, sizeof(body)) || !set_text(body, text, sizeof(text), key, sizeof(key)))
    return send_text(req, "400 Bad Request", "Body: {\"key\": name, \"value\": value}");
  return command(req, text, key);
}

esp_err_t cmd_post(httpd_req_t* req) { return command(req, (const char*)req->user_ctx, ""); }

void reg(httpd_handle_t server) {
  static const httpd_uri_t U[] = {
    {"/settings", HTTP_GET, page_get, nullptr},
    {"/api/settings", HTTP_GET, settings_get, nullptr},
    {"/api/set", HTTP_POST, set_post, nullptr},
    {"/api/save", HTTP_POST, cmd_post, (void*)"save"},
    {"/api/erase", HTTP_POST, cmd_post, (void*)"config erase"},
    {"/api/restart", HTTP_POST, cmd_post, (void*)"restart"},
    {"/api/stop", HTTP_POST, cmd_post, (void*)"run stop"},
  };
  for (const httpd_uri_t& u : U) httpd_register_uri_handler(server, &u);
}

}  // namespace

void begin() {
  if (!s_done) s_done = xSemaphoreCreateBinary();
  web::addPage("/settings", "Settings", reg);
}

void service(uint32_t now_ms) {
  if (s_restart_at && (int32_t)(now_ms - s_restart_at) >= 0) restartApp();
  if (s_req.state != PENDING) return;
  portENTER_CRITICAL(&s_mux);
  const bool go = s_req.state == PENDING;
  if (go) s_req.state = RUNNING;
  portEXIT_CRITICAL(&s_mux);
  if (!go) return;
  if (!s_req.text[0]) {  // GET /api/settings: a copy of the settings
    s_snap = g_deviceConfig;
    finish(0, "");
    return;
  }
  String reply;
  bool deferred = false;
  const uint8_t code = webCommand(s_req.text, reply, &deferred);
  if (deferred) { s_req.state = WAIT_ANSWER; return; }
  finish(code, reply);
}

void answer(uint8_t code, const String& reply) {
  if (s_req.state == WAIT_ANSWER) finish(code, reply);
}

}  // namespace webcfg
